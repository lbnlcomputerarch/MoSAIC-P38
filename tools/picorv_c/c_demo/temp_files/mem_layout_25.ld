MEMORY
{
	PICO0 (rw) : ORIGIN = 0x00000000, LENGTH = 0x004000
	SPAD8 (rw) : ORIGIN = 0x00020000, LENGTH = 0x004000
	PICO16 (rw) : ORIGIN = 0x00040000, LENGTH = 0x004000
	PICO24 (rw) : ORIGIN = 0x00060000, LENGTH = 0x004000
	PICO32 (rw) : ORIGIN = 0x00080000, LENGTH = 0x004000
	PICO40 (rw) : ORIGIN = 0x000a0000, LENGTH = 0x004000
	PICO48 (rw) : ORIGIN = 0x000c0000, LENGTH = 0x004000
	PICO56 (rw) : ORIGIN = 0x000e0000, LENGTH = 0x004000
	PICO1 (rw) : ORIGIN = 0x00004000, LENGTH = 0x004000
	PICO9 (rw) : ORIGIN = 0x00024000, LENGTH = 0x004000
	PICO17 (rw) : ORIGIN = 0x00044000, LENGTH = 0x004000
	LOCAL (xrw) : ORIGIN = 0x00064200, LENGTH = 0x003E00
	PICO33 (rw) : ORIGIN = 0x00084000, LENGTH = 0x004000
	PICO41 (rw) : ORIGIN = 0x000a4000, LENGTH = 0x004000
	PICO49 (rw) : ORIGIN = 0x000c4000, LENGTH = 0x004000
	PICO57 (rw) : ORIGIN = 0x000e4000, LENGTH = 0x004000
	PICO2 (rw) : ORIGIN = 0x00008000, LENGTH = 0x004000
	PICO10 (rw) : ORIGIN = 0x00028000, LENGTH = 0x004000
	PICO18 (rw) : ORIGIN = 0x00048000, LENGTH = 0x004000
	PICO26 (rw) : ORIGIN = 0x00068000, LENGTH = 0x004000
	PICO34 (rw) : ORIGIN = 0x00088000, LENGTH = 0x004000
	PICO42 (rw) : ORIGIN = 0x000a8000, LENGTH = 0x004000
	PICO50 (rw) : ORIGIN = 0x000c8000, LENGTH = 0x004000
	PICO58 (rw) : ORIGIN = 0x000e8000, LENGTH = 0x004000
	PICO3 (rw) : ORIGIN = 0x0000c000, LENGTH = 0x004000
	PICO11 (rw) : ORIGIN = 0x0002c000, LENGTH = 0x004000
	PICO19 (rw) : ORIGIN = 0x0004c000, LENGTH = 0x004000
	PICO27 (rw) : ORIGIN = 0x0006c000, LENGTH = 0x004000
	PICO35 (rw) : ORIGIN = 0x0008c000, LENGTH = 0x004000
	PICO43 (rw) : ORIGIN = 0x000ac000, LENGTH = 0x004000
	PICO51 (rw) : ORIGIN = 0x000cc000, LENGTH = 0x004000
	PICO59 (rw) : ORIGIN = 0x000ec000, LENGTH = 0x004000
	PICO4 (rw) : ORIGIN = 0x00010000, LENGTH = 0x004000
	PICO12 (rw) : ORIGIN = 0x00030000, LENGTH = 0x004000
	PICO20 (rw) : ORIGIN = 0x00050000, LENGTH = 0x004000
	PICO28 (rw) : ORIGIN = 0x00070000, LENGTH = 0x004000
	PICO36 (rw) : ORIGIN = 0x00090000, LENGTH = 0x004000
	PICO44 (rw) : ORIGIN = 0x000b0000, LENGTH = 0x004000
	PICO52 (rw) : ORIGIN = 0x000d0000, LENGTH = 0x004000
	PICO60 (rw) : ORIGIN = 0x000f0000, LENGTH = 0x004000
	PICO5 (rw) : ORIGIN = 0x00014000, LENGTH = 0x004000
	PICO13 (rw) : ORIGIN = 0x00034000, LENGTH = 0x004000
	PICO21 (rw) : ORIGIN = 0x00054000, LENGTH = 0x004000
	PICO29 (rw) : ORIGIN = 0x00074000, LENGTH = 0x004000
	PICO37 (rw) : ORIGIN = 0x00094000, LENGTH = 0x004000
	PICO45 (rw) : ORIGIN = 0x000b4000, LENGTH = 0x004000
	PICO53 (rw) : ORIGIN = 0x000d4000, LENGTH = 0x004000
	PICO61 (rw) : ORIGIN = 0x000f4000, LENGTH = 0x004000
	PICO6 (rw) : ORIGIN = 0x00018000, LENGTH = 0x004000
	PICO14 (rw) : ORIGIN = 0x00038000, LENGTH = 0x004000
	PICO22 (rw) : ORIGIN = 0x00058000, LENGTH = 0x004000
	PICO30 (rw) : ORIGIN = 0x00078000, LENGTH = 0x004000
	PICO38 (rw) : ORIGIN = 0x00098000, LENGTH = 0x004000
	PICO46 (rw) : ORIGIN = 0x000b8000, LENGTH = 0x004000
	PICO54 (rw) : ORIGIN = 0x000d8000, LENGTH = 0x004000
	PICO62 (rw) : ORIGIN = 0x000f8000, LENGTH = 0x004000
	MYDATA0 (rw) : ORIGIN = 0x0001C000, LENGTH = 0x004000
	MYDATA1 (rw) : ORIGIN = 0x0003C000, LENGTH = 0x004000
	MYDATA2 (rw) : ORIGIN = 0x0005C000, LENGTH = 0x004000
	MYDATA3 (rw) : ORIGIN = 0x0007C000, LENGTH = 0x004000
	MYDATA  (rw) : ORIGIN = 0x00080000, LENGTH = 0x004000
}
